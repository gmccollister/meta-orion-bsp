## conf/machine/orionlxm.conf
```bitbake
#@TYPE: Machine
#@NAME: OrionLXm machine
#@DESCRIPTION: Machine configuration for OrionLXm

MACHINE_EXTRA_RRECOMMENDS = " kernel-modules kernel-devicetree"

DEFAULTTUNE ?= "cortexa8hf-neon"
include conf/machine/include/tune-cortexa8.inc

IMAGE_FSTYPES += "tar.gz"

SERIAL_CONSOLE = "115200 ttyO0"

PREFERRED_PROVIDER_virtual/kernel ?= "linux-yocto"
PREFERRED_VERSION_linux-yocto ?= "3.19%"

KERNEL_IMAGETYPE = "uImage"
KERNEL_DEVICETREE = "am335x-lxm.dtb"
KERNEL_EXTRA_ARGS += "LOADADDR=0x80008000"

MACHINE_FEATURES = "usbhost vfat"
```
